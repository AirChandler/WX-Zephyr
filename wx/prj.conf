## CMakeLists.txt
```
cmake_minimum_required(VERSION 3.18.3)

#set(CMAKE_CXX_FLAGS "-fpermissive")
set( USE_ZEPHYR ON CACHE INTERNAL "" )
set( ZEPHYR_BASE "${CMAKE_CURRENT_LIST_DIR}/../zephyrproject/zephyr" )

# config board
set( BOARD_ROOT ${ZEPHYR_BASE} )

# config toolchain
set( ZEPHYR_TOOLCHAIN_VARIANT gnuarmemb )
#set (ZEPHYR_SDK_INSTALL_DIR "/home/zephyr-sdk-0.13.1")
set( GNUARMEMB_TOOLCHAIN_PATH "C:/GNU_Arm_Embedded_GCC" ) #!!! todo: set toolchain path default from env if exists, expose as cmake config var 

# config external modules (usually initialised with west update on new zephyr installs)
list( APPEND ZEPHYR_MODULES
    "${CMAKE_CURRENT_LIST_DIR}/../zephyrproject/modules/hal/stm32"
    "${CMAKE_CURRENT_LIST_DIR}/../zephyrproject/modules/hal/nordic"
    "${CMAKE_CURRENT_LIST_DIR}/../zephyrproject/modules/hal/cmsis"
    "${CMAKE_CURRENT_LIST_DIR}/../zephyrproject/modules/hal/st"
    "${CMAKE_CURRENT_LIST_DIR}/../zephyrproject/modules/debug/segger"
    "${CMAKE_CURRENT_LIST_DIR}/../zephyrproject/modules/crypto/mbedtls"
    "${CMAKE_CURRENT_LIST_DIR}/../zephyrproject/modules/lib/openthread"
)
#set(MCUBOOT_DIR "${ZEPHYR_BASE}/mcuboot") if using MCUBoot... may not be right
#set(TOOLS_DIR "${TZEPHYR_BASE}/tools") if using any tools... may not be right

find_package(Zephyr REQUIRED HINTS ${ZEPHYR_BASE} )
project(wx_zephyr)

list( APPEND SRCS
    "${PROJECT_SOURCE_DIR}/src/main.cpp"
    "${PROJECT_SOURCE_DIR}/drivers/stm32/BSP/STM32H735G-DK/stm32h735g_discovery_lcd.c"
)

list( APPEND INCS
    "${PROJECT_SOURCE_DIR}/inc"
    "${PROJECT_SOURCE_DIR}/drivers/stm32/BSP/STM32H735G-DK/"
    "${PROJECT_SOURCE_DIR}/drivers/stm32/BSP/Components/Common"
    "${PROJECT_SOURCE_DIR}/drivers/stm32/BSP/Components/rk043fn48h"
)

add_compile_options( -Wall -Wextra -Wno-unused-parameter -Wno-unused-variable )

target_sources( app PRIVATE ${SRCS} )
target_include_directories( app PRIVATE ${INCS} )
target_link_options( app PUBLIC "-Wl,-Map=app.map,--cref" )
```

## prj.conf
```kconfig
#Zephyr Kernel Config
CONFIG_CONSOLE=y
CONFIG_UART_CONSOLE=y
CONFIG_PRINTK=y
CONFIG_NEWLIB_LIBC=y
CONFIG_NEWLIB_LIBC_NANO=n
CONFIG_NEWLIB_LIBC_MIN_REQUIRED_HEAP_SIZE=0

#C++ CONFIG
CONFIG_CPLUSPLUS=y
CONFIG_STD_CPP17=y
CONFIG_LIB_CPLUSPLUS=y
CONFIG_EXCEPTIONS=y
CONFIG_RTTI=y
```

## src/main.cpp
```c
/**
 * @file main.cpp
 * @author Chandler Keep (chandlersamkeep@gmail.com)
 * @brief 
 * @version 0.1
 * @date 2021-12-18
 * 
 * @copyright Copyright (c)
 * 
 */
#include "main.hpp"

void main(void)
{
	#if defined(CONFIG_SOC_STM32H735XX)
		__GPIOC_CLK_ENABLE();
	#endif
	while(1){
		printk("Hello World!\n");
		k_msleep(1000);
	}
}
```

## inc/main.hpp
```c
/**
 * @file main.hpp
 * @author chandler keep (chandlersamkeep@gmail.com)
 * @brief 
 * @version 0.1
 * @date 2021-12-18
 * 
 * @copyright Copyright (c) 2021
 * 
 */
#include <zephyr.h>
#include <kernel.h>
#include <console/console.h>
#if defined(CONFIG_SOC_STM32H735XX)
	#include <stm32h7xx_hal.h>
	#include <stm32h7xx_hal_gpio.h>
#endif
```
